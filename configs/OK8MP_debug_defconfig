## configs/OK8MP_debug_defconfig
```kconfig
BR2_aarch64=y
BR2_KERNEL_HEADERS_5_10=y
BR2_ENABLE_DEBUG=y
BR2_TARGET_GENERIC_HOSTNAME="R0xy"
BR2_TARGET_GENERIC_ISSUE="Welcome, alive now"
BR2_ROOTFS_DEVICE_CREATION_DYNAMIC_EUDEV=y
BR2_ROOTFS_MERGED_USR=y
BR2_ROOTFS_MERGED_BIN=y
BR2_TARGET_GENERIC_ROOT_PASSWD="root"
BR2_SYSTEM_DEFAULT_PATH="/bin:/sbin:/usr/bin:/usr/sbin"
BR2_TARGET_TZ_INFO=y
BR2_TARGET_LOCALTIME="Asia/Shanghai"
BR2_ROOTFS_OVERLAY="board/forlinx/ok8mp/rootfs-overlay"
BR2_ROOTFS_POST_BUILD_SCRIPT="./custom_post_build.sh"
BR2_PACKAGE_BUSYBOX_SHOW_OTHERS=y
BR2_PACKAGE_ALSA_UTILS=y
BR2_PACKAGE_ALSA_UTILS_ALSACONF=y
BR2_PACKAGE_ALSA_UTILS_ACONNECT=y
BR2_PACKAGE_ALSA_UTILS_ALSALOOP=y
BR2_PACKAGE_ALSA_UTILS_ALSAUCM=y
BR2_PACKAGE_ALSA_UTILS_ALSATPLG=y
BR2_PACKAGE_ALSA_UTILS_AMIDI=y
BR2_PACKAGE_ALSA_UTILS_AMIXER=y
BR2_PACKAGE_ALSA_UTILS_APLAY=y
BR2_PACKAGE_ALSA_UTILS_APLAYMIDI=y
BR2_PACKAGE_ALSA_UTILS_ARECORDMIDI=y
BR2_PACKAGE_ALSA_UTILS_ASEQDUMP=y
BR2_PACKAGE_ALSA_UTILS_ASEQNET=y
BR2_PACKAGE_ALSA_UTILS_BAT=y
BR2_PACKAGE_ALSA_UTILS_IECSET=y
BR2_PACKAGE_ALSA_UTILS_SPEAKER_TEST=y
BR2_PACKAGE_JACK1=y
BR2_PACKAGE_OPUS_TOOLS=y
BR2_PACKAGE_PIPEWIRE=y
BR2_PACKAGE_PIPEWIRE_COMPRESS_OFFLOAD=y
BR2_PACKAGE_PIPEWIRE_EXAMPLES=y
BR2_PACKAGE_PIPEWIRE_V4L2=y
BR2_PACKAGE_PIPEWIRE_MEDIA_SESSION=y
BR2_PACKAGE_PULSEAUDIO=y
BR2_PACKAGE_PULSEAUDIO_DAEMON=y
BR2_PACKAGE_WAVPACK=y
BR2_PACKAGE_BZIP2=y
BR2_PACKAGE_XZ=y
BR2_PACKAGE_ZIP=y
BR2_PACKAGE_BLKTRACE=y
BR2_PACKAGE_BPFTOOL=y
BR2_PACKAGE_CACHE_CALIBRATOR=y
BR2_PACKAGE_FIO=y
BR2_PACKAGE_IOZONE=y
BR2_PACKAGE_LIBBPF=y
BR2_PACKAGE_LMBENCH=y
BR2_PACKAGE_LSOF=y
BR2_PACKAGE_LTP_TESTSUITE=y
BR2_PACKAGE_NETPERF=y
BR2_PACKAGE_SPIDEV_TEST=y
BR2_PACKAGE_STRACE=y
BR2_PACKAGE_STRESS=y
BR2_PACKAGE_STRESS_NG=y
BR2_PACKAGE_TRACE_CMD=y
BR2_PACKAGE_VALGRIND=y
BR2_PACKAGE_BINUTILS_TARGET=y
BR2_PACKAGE_BITWISE=y
BR2_PACKAGE_FLEX=y
BR2_PACKAGE_GAWK=y
BR2_PACKAGE_GREP=y
BR2_PACKAGE_MAKE=y
BR2_PACKAGE_PKGCONF=y
BR2_PACKAGE_SED=y
BR2_PACKAGE_TREE=y
BR2_PACKAGE_E2FSPROGS=y
BR2_PACKAGE_COMIX_CURSORS=y
BR2_PACKAGE_MEMTESTER=y
BR2_PACKAGE_MEMTOOL=y
BR2_PACKAGE_PARTED=y
BR2_PACKAGE_ALSA_PLUGINS=y
BR2_PACKAGE_LIBMD=y
BR2_PACKAGE_FONTCONFIG=y
BR2_PACKAGE_JPEG=y
BR2_PACKAGE_LCMS2=y
BR2_PACKAGE_CPUINFO=y
BR2_PACKAGE_DTC=y
BR2_PACKAGE_DTC_PROGRAMS=y
BR2_PACKAGE_LIBGPIOD=y
BR2_PACKAGE_LIBGPIOD_TOOLS=y
BR2_PACKAGE_LIBGUDEV=y
BR2_PACKAGE_LIBIIO=y
BR2_PACKAGE_LIBNFC=y
BR2_PACKAGE_LIBSOC=y
BR2_PACKAGE_LIBUSB_EXAMPLES=y
BR2_PACKAGE_LIBUSBGX=y
BR2_PACKAGE_LIBYAML=y
BR2_PACKAGE_LIBNETCONF2=y
BR2_PACKAGE_LIBNETCONF2_SSH_TLS=y
BR2_PACKAGE_LIBNL_TOOLS=y
BR2_PACKAGE_LIBEVDEV=y
BR2_PACKAGE_AUTOSSH=y
BR2_PACKAGE_CAN_UTILS=y
BR2_PACKAGE_CHRONY=y
BR2_PACKAGE_DHCPDUMP=y
BR2_PACKAGE_DNSMASQ=y
BR2_PACKAGE_ETHTOOL=y
BR2_PACKAGE_HOSTAPD=y
BR2_PACKAGE_IPERF3=y
BR2_PACKAGE_NET_TOOLS=y
BR2_PACKAGE_OPENSSH=y
BR2_PACKAGE_SOCKETCAND=y
BR2_PACKAGE_SSHGUARD=y
BR2_PACKAGE_TCPDUMP=y
BR2_PACKAGE_TFTPD=y
BR2_PACKAGE_WIRELESS_REGDB=y
BR2_PACKAGE_WIRELESS_TOOLS=y
BR2_PACKAGE_WIRELESS_TOOLS_IFRENAME=y
BR2_PACKAGE_WPA_SUPPLICANT=y
BR2_PACKAGE_WPA_SUPPLICANT_AP_SUPPORT=y
BR2_PACKAGE_WPA_SUPPLICANT_WIFI_DISPLAY=y
BR2_PACKAGE_COREUTILS=y
BR2_PACKAGE_CPULOAD=y
BR2_PACKAGE_HTOP=y
BR2_PACKAGE_KMOD_TOOLS=y
BR2_PACKAGE_NCDU=y
BR2_PACKAGE_NUMACTL=y
BR2_PACKAGE_UTIL_LINUX_BINARIES=y
BR2_PACKAGE_UTIL_LINUX_AGETTY=y
BR2_PACKAGE_UTIL_LINUX_FSCK=y
BR2_PACKAGE_UTIL_LINUX_IRQTOP=y
BR2_PACKAGE_UTIL_LINUX_KILL=y
BR2_PACKAGE_UTIL_LINUX_LSMEM=y
BR2_PACKAGE_UTIL_LINUX_MORE=y
BR2_PACKAGE_UTIL_LINUX_MOUNT=y
BR2_PACKAGE_UTIL_LINUX_MOUNTPOINT=y
BR2_PACKAGE_UTIL_LINUX_SULOGIN=y
BR2_PACKAGE_VIM=y
BR2_TARGET_ROOTFS_EXT2=y
BR2_TARGET_ROOTFS_EXT2_4=y
BR2_TARGET_ROOTFS_EXT2_SIZE="1024M"
BR2_PACKAGE_HOST_PYTHON3=y
BR2_PACKAGE_HOST_ZIP=y
```

## configs/OK8MP_defconfig
```kconfig
BR2_aarch64=y
BR2_KERNEL_HEADERS_5_10=y
BR2_ENABLE_DEBUG=y
BR2_TARGET_GENERIC_HOSTNAME="R0xy"
BR2_TARGET_GENERIC_ISSUE="Welcome for R0xy"
BR2_ROOTFS_DEVICE_CREATION_DYNAMIC_EUDEV=y
BR2_ROOTFS_MERGED_USR=y
BR2_ROOTFS_MERGED_BIN=y
# BR2_TARGET_ENABLE_ROOT_LOGIN is not set
BR2_SYSTEM_DEFAULT_PATH="/bin:/sbin:/usr/bin:/usr/sbin"
BR2_TARGET_TZ_INFO=y
BR2_TARGET_LOCALTIME="Asia/Shanghai"
BR2_ROOTFS_OVERLAY="board/forlinx/ok8mp/rootfs-overlay"
BR2_ROOTFS_POST_BUILD_SCRIPT="./custom_post_build.sh"
BR2_PACKAGE_BUSYBOX_SHOW_OTHERS=y
BR2_PACKAGE_BZIP2=y
BR2_PACKAGE_XZ=y
BR2_PACKAGE_ZIP=y
BR2_PACKAGE_BLKTRACE=y
BR2_PACKAGE_CACHE_CALIBRATOR=y
BR2_PACKAGE_IOZONE=y
BR2_PACKAGE_LIBTRACEFS=y
BR2_PACKAGE_LMBENCH=y
BR2_PACKAGE_LSOF=y
BR2_PACKAGE_NETPERF=y
BR2_PACKAGE_SPIDEV_TEST=y
BR2_PACKAGE_STRESS=y
BR2_PACKAGE_VALGRIND=y
BR2_PACKAGE_BITWISE=y
BR2_PACKAGE_FLEX=y
BR2_PACKAGE_LIBTOOL=y
BR2_PACKAGE_MAKE=y
BR2_PACKAGE_PKGCONF=y
BR2_PACKAGE_E2FSPROGS=y
BR2_PACKAGE_COMIX_CURSORS=y
BR2_PACKAGE_DBUS=y
BR2_PACKAGE_LIBMD=y
BR2_PACKAGE_FONTCONFIG=y
BR2_PACKAGE_JPEG=y
BR2_PACKAGE_LCMS2=y
BR2_PACKAGE_CPUINFO=y
BR2_PACKAGE_DTC=y
BR2_PACKAGE_DTC_PROGRAMS=y
BR2_PACKAGE_LIBIIO=y
BR2_PACKAGE_LIBNFC=y
BR2_PACKAGE_LIBSOC=y
BR2_PACKAGE_LIBUSB_EXAMPLES=y
BR2_PACKAGE_LIBUSBGX=y
BR2_PACKAGE_LIBYAML=y
BR2_PACKAGE_LIBNETCONF2=y
BR2_PACKAGE_LIBNETCONF2_SSH_TLS=y
BR2_PACKAGE_LIBNL_TOOLS=y
BR2_PACKAGE_LIBEVDEV=y
BR2_PACKAGE_LIBFFI=y
BR2_PACKAGE_AUTOSSH=y
BR2_PACKAGE_CAN_UTILS=y
BR2_PACKAGE_CHRONY=y
BR2_PACKAGE_DHCPDUMP=y
BR2_PACKAGE_DNSMASQ=y
BR2_PACKAGE_ETHTOOL=y
BR2_PACKAGE_HOSTAPD=y
BR2_PACKAGE_IPERF3=y
BR2_PACKAGE_NET_TOOLS=y
BR2_PACKAGE_OPENSSH=y
BR2_PACKAGE_SOCKETCAND=y
BR2_PACKAGE_SSHGUARD=y
BR2_PACKAGE_TCPDUMP=y
BR2_PACKAGE_TFTPD=y
BR2_PACKAGE_WIRELESS_REGDB=y
BR2_PACKAGE_WIRELESS_TOOLS=y
BR2_PACKAGE_WIRELESS_TOOLS_IFRENAME=y
BR2_PACKAGE_WPA_SUPPLICANT=y
BR2_PACKAGE_WPA_SUPPLICANT_AP_SUPPORT=y
BR2_PACKAGE_WPA_SUPPLICANT_WIFI_DISPLAY=y
BR2_PACKAGE_CPULOAD=y
BR2_PACKAGE_HTOP=y
BR2_PACKAGE_KMOD_TOOLS=y
BR2_PACKAGE_NCDU=y
BR2_PACKAGE_NUMACTL=y
BR2_PACKAGE_UTIL_LINUX_BINARIES=y
BR2_PACKAGE_UTIL_LINUX_AGETTY=y
BR2_PACKAGE_UTIL_LINUX_FSCK=y
BR2_PACKAGE_UTIL_LINUX_IRQTOP=y
BR2_PACKAGE_UTIL_LINUX_KILL=y
BR2_PACKAGE_UTIL_LINUX_LSMEM=y
BR2_PACKAGE_UTIL_LINUX_MORE=y
BR2_PACKAGE_UTIL_LINUX_MOUNT=y
BR2_PACKAGE_UTIL_LINUX_MOUNTPOINT=y
BR2_PACKAGE_UTIL_LINUX_SULOGIN=y
BR2_TARGET_ROOTFS_EXT2=y
BR2_TARGET_ROOTFS_EXT2_4=y
BR2_TARGET_ROOTFS_EXT2_SIZE="1024M"
BR2_PACKAGE_HOST_MKPASSWD=y
BR2_PACKAGE_HOST_PYTHON3=y
BR2_PACKAGE_HOST_ZIP=y
```
